## build/conf/bblayers.conf
```bitbake
# LAYER_CONF_VERSION is increased each time build/conf/bblayers.conf
# changes incompatibly
LCONF_VERSION = "6"

BBPATH = "${TOPDIR}"
BBFILES ?= ""

BBLAYERS ?= " \
  /home/peernohell/projects/yocto-builder/poky/meta \
  /home/peernohell/projects/yocto-builder/poky/meta-yocto \
  /home/peernohell/projects/yocto-builder/poky/meta-yocto-bsp \
  "
BBLAYERS_NON_REMOVABLE ?= " \
  /home/peernohell/projects/yocto-builder/poky/meta \
  /home/peernohell/projects/yocto-builder/poky/meta-yocto \
  "
#BBLAYERS ?= " \
#  /yocto-builder/poky/meta \
#  /yocto-builder/poky/meta-yocto \
#  /yocto-builder/poky/meta-yocto-bsp \
#  "
#BBLAYERS_NON_REMOVABLE ?= " \
#  /yocto-builder/poky/meta \
#  /yocto-builder/poky/meta-yocto \
#  "
```
